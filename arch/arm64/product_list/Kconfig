## coolpad/drivers/sensors/invensense/magnetometer/Kconfig
```kconfig
#
# Magnetometer sensors
#
menu "Magnetometer sensors"

config YL_SENSORS_YAS533
	tristate "Yamaha 3-Axis Magnetometer"
	depends on I2C && SYSFS && IIO && IIO_SW_RING && IIO_TRIGGER
	help
	  Say Y here to add support for the Yamaha 3-Axis Magnetometer.

config YL_SENSORS_YAS537
	tristate "Yamaha 3-Axis Magnetometer"
	depends on I2C && SYSFS && IIO && IIO_SW_RING && IIO_TRIGGER
	help
	   Say Y here to add support for the Yamaha 3-Axis Magnetometer.

config YL_SENSORS_AKM09911
       tristate "Akm 3-Axis Magnetometer"
       depends on I2C
       help
          Say Y here to add support for the Akm 3-Axis Magnetometer.
	   
endmenu
```

## coolpad/drivers/sensors/sensparams/Kconfig
```kconfig
############################################
## 	Kconfig for sensors params
## 	Author:LongJiang
## 	Date:2013-09-13
############################################

config YL_SENSORS_PARAMS
	tristate "sensor calibration params storage Support"
	depends on I2C && MMC_YL_PARAMS
	help
	  sensor calibration params storage Driver
```

## coolpad/drivers/staging/iio/magnetometer/Kconfig
```kconfig
#
# Magnetometer sensors
#

config SENSORS_YAS_MAGNETOMETER
	tristate "Yamaha 3-Axis Magnetometer"
	depends on I2C && SYSFS && IIO && IIO_KFIFO_BUF && IIO_TRIGGER
	help
	  Say Y here to add support for the Yamaha 3-Axis Magnetometer.


config SENSORS_BMA_ACCELEROMETER
	tristate "Yamaha 3-Axis Accelerometer"
	depends on I2C && SYSFS && IIO && IIO_KFIFO_BUF && IIO_TRIGGER
	help
	  Say Y here to add support for the yamaha 3-Axis Accelerometer.

	  To compile this driver as a module, choose M here: the module
	  will be called bma250e.

config SENSORS_LIS3DH_ACCELEROMETER
	tristate "Yamaha 3-Axis Accelerometer"
	depends on I2C && SYSFS && IIO && IIO_KFIFO_BUF && IIO_TRIGGER 
	help
	  Say Y here to add support for the yamaha 3-Axis Accelerometer.

	  To compile this driver as a module, choose M here: the module
	  will be called lis3dh.

config SENSORS_KXTJ2_ACCELEROMETER
	tristate "Yamaha 3-Axis Accelerometer"
	depends on I2C && SYSFS && IIO && IIO_KFIFO_BUF && IIO_TRIGGER
	help
	  Say Y here to add support for the yamaha 3-Axis Accelerometer.

	  To compile this driver as a module, choose M here: the module
	  will be called kionix.
config YAS_MAG_DRIVER
	int "Yamaha Magnetometer Driver Enum"
	depends on SENSORS_YAS_MAGNETOMETER
	help
	  Yamaha Magnetometer Driver Enum, the values mapping to yas_cfg.h

config YAS_ACC_DRIVER
	int "Yamaha Accelerometer Driver Enum"
	depends on SENSORS_YAS_MAGNETOMETER
	help
	  Yamaha Accelerometer Driver Enum, the values mapping to yas_cfg.h
```

## coolpad/drivers/usb/typec/Kconfig
```kconfig
config USB_TYPEC_FUSB302
	boolean "USB 2.0 TYPE C"
config USB_TYPEC_PD_SUPPORT
	boolean "pd	SUPPORT"
config YL_FAIRCHILDIC_USB_TYPEC
	boolean "fairchild TYPEC IC"
```
