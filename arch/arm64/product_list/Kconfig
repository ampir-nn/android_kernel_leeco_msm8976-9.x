## arch/arm64/product_list/Kconfig
```kconfig
menuconfig YULONG_PRODUCT
	bool "Enable yulong product configs"
	default n
	help
	  YULONG_PRODUCT only enabled from yl_config.sh to indicate that
	  it is yulong products, and the product name and hardware version
	  shall be defined.

if YULONG_PRODUCT
config YL_DEBUG
	bool "yulong debug"
	help
	  CONFIG_YL_DEBUG will be enable in eng version, but disable in usr version.
	  You can use CONFIG_YL_DEBUG to print more debug message without impact
	  release version.

choice
	prompt "Yulong project name"
	default BOARD_CPSAMPLE

config BOARD_CPSAMPLE
	bool "CPSAMPLE board"
	depends on ARCH_MSM8916
	help
	  Support for Yulong CPSAMPLE product

config BOARD_C1
	bool "C1 board"
	depends on ARCH_MSM8916
	help
	 Support for Letv C1 product (MSM8976)

config BOARD_C2
        bool "C2 board"
        depends on ARCH_MSM8916
        help
         Support for Letv C2 product (MSM8976)

config BOARD_C107
        bool "C107 board"
        depends on ARCH_MSM8916
        help
         Support for Letv C107 product (MSM8976)
endchoice

choice
	prompt "Yulong hardware version"
	default BOARD_VER_T0

config BOARD_VER_T0
	bool "hardware version T0"
	help
	  This is hareware version T0

config BOARD_VER_T1
	bool "hardware version T1"
	help
	  This is hareware version T1

config BOARD_VER_T2
	bool "hardware version T2"
	help
	  This is hareware version T2

config BOARD_VER_T3
	bool "hardware version T3"
	help
	  This is hareware version T3

config BOARD_VER_T4
	bool "hardware version T4"
	help
	  This is hareware version T4

config BOARD_VER_P0
	bool "hardware version P0"
	help
	  This is hareware version P0

config BOARD_VER_P1
	bool "hardware version P1"
	help
	  This is hareware version P1

config BOARD_VER_P2
	bool "hardware version P2"
	help
	  This is hareware version P2

config BOARD_VER_P3
	bool "hardware version P3"
	help
	  This is hareware version P3

config BOARD_VER_P4
	bool "hardware version P4"
	help
	  This is hareware version P4

endchoice
endif

#Date			Author			Why					jira
#2015-12-19		xingbin		add s2_msm8952.dtsi		LAFITE-237
#========================================================
#==========QL1530 CONFIG BEGIN===========================
config PRODUCT_S2
	depends on ARCH_MSM8916
	bool "PRODUCT_S2 Support"
	help
	  Fix version type as PRODUCT_S2
```

## coolpad/drivers/input/fingerprint/fpc_tsf/Kconfig
```kconfig
config FPC_TSF_FINGERPRINT
       default n
       tristate "FPC 1020 family fingerprint sensor support"
       depends on SPI_MASTER
```

## coolpad/drivers/input/touchscreen/Kconfig
```kconfig
#
# Touchscreen driver configuration

#add by litao3 2013.12.28 begin
config TOUCHSCREEN_FOCALTECH
	tristate "focaltech ft5x0x touchscreen"
	depends on I2C
	help
	  Say Y here if you want support for Focaltech touchscreen.

	  If unsure, say Y.
	  To compile this driver as a module, choose M here: the
	  module will be called ft5x0x_ts
#add by litao3 2013.12.28 end

config TOUCHSCREEN_FOCALTECH_TS
	tristate "focaltech ft6x36 touchscreen"
	depends on I2C
	help
	  Say Y here if you want support for Focaltech touchscreen.

	  If unsure, say Y.
	  To compile this driver as a module, choose M here: the
	  module will be called ft6x36_ts

config TOUCHSCREEN_GOODIX
	tristate "Goodix I2C touchscreen"
	depends on I2C
	help
	  Say Y here if you have a Goodix I2C touchscreen
	  connected to your system.

	  If unsure, say N.

	  To compile this driver as a module, choose M here: the
	  module will be called goodix_ts.

config TOUCHSCREEN_GOODIX_TS
	bool "Goodix touchpanel GT9xx series"
	depends on I2C
	help
	  Say Y here if you have a Goodix GT9xx touchscreen.
	  Gt9xx controllers are multi touch controllers which can
	  report 5 touches at a time.
	  If unsure, say N.

config TOUCHSCREEN_GT1XX
	bool "Goodix touchpanel GT1xx series"
	depends on I2C
	help
	  Say Y here if you have a Goodix GT11XX touchscreen.
	  Gt9xx controllers are multi touch controllers which can
	  report 5 touches at a time.

	  If unsure, say N.

config TOUCHSCREEN_SYNAPTICS_TS
	tristate "Synaptics  RMI4 touchscreen"
	depends on I2C
	help
	  Say Y here if you have a Synaptics I2C touchscreen
	  connected to your system.

	  If unsure, say N.

	  To compile this driver as a module, choose M here: the
	  module will be called RMI4_TS.

config TOUCHSCREEN_FOCALTECH_5446
	bool "Focaltech ft5446"
	depends on I2C
	help
	  Say Y here if you have a focaltech 5446 touchscreen.
	  ft5446 controllers are multi touch controllers which can
	  report 5 touches at a time.

	  If unsure, say N.

config TOUCHSCREEN_FOCALTECH_5346
	bool "Focaltech ft5346"
	depends on I2C
	help
	  Say Y here if you have a focaltech 5346 touchscreen.
	  ft5346 controllers are multi touch controllers which can
	  report 5 touches at a time.

	  If unsure, say N.

config TOUCHSCREEN_SYNAPTICS_TS_TEST_REPORTING
	bool "Synaptics_dsx test reporting"
	depends on TOUCHSCREEN_SYNAPTICS_TS
	default n
	help
	  Say Y here if you need to do advanced test for the TW IC.

	  synaptics_dsx_test_reporting.c will provide you some devnode for you.
	  such as input0/f54/noise_density, input0/f54/get_report,input0/f54/force_cal,etc..
	  The devnodes are writeable,this will cause the CTS test not pass.

config TOUCHSCREEN_HAL
	tristate "platform touchscreens dev: HAL for Factory Mode Test"
	depends on I2C
	default n
	help
	  Say Y here if you need the platform touchscreens HAL dev for Factory Mode Test

config FACTORY_TW_FIRMWARE_UPDATE
	tristate "The flag of TW firmware update only in factory mode"
	default n
	help
	  Say Y here if you don't want to update TW firmware when power on.

config TOUCHSCREEN_GESTURE_WAKEUP
	bool "touchscreen gesture wakeup function"
	depends on I2C
	default n
	help
	  Say Y here to enable support for gesture wakeup.
	  If unsure, say N.

config TOUCHSCREEN_GLOVE
	bool "touchscreen glove mode support"
	depends on I2C
	default n
	help
	  Say Y here to enable support for glove.
	  If unsure, say N.


config TOUCHSCREEN_SYNAPTICS_DSX
	tristate "Synaptics DSX touchscreen"
	depends on I2C
	help
	  Say Y here if you have a Synaptics I2C touchscreen
	  connected to your system.

	  If unsure, say N.

	  To compile this driver as a module, choose M here: the
	  module will be called RMI4_DSX.

#for sharp touchscreen
source "coolpad/drivers/input/touchscreen/shtsc/Kconfig"
```

## coolpad/drivers/leds/Kconfig
```kconfig
config LEDS_SGM3780_FLASH
	tristate "Support for GPIO Flash LEDs"
	help
	  This driver supports the leds functionality of GPIO Flash LED. It
	  includes flash mode and torch mode.

	  To compile this driver as a module, choose M here.

config LEDS_TORCH_ONLY_FLASH
	tristate "Support for GPIO Flash LEDs -Only Torch Mode"
	help
	  This driver supports the leds functionality of GPIO Flash LED. It
	  includes flash mode and torch mode.

config YL_LEDS_AW2013
	tristate "LED driver for AW2013 RGB LED"
	depends on LEDS_CLASS
	depends on I2C
	help
	  This option enables support for AW2013 RGB LED driver chips
	  accessed via the I2C bus.

config YL_LEDS_AW2013_HQ
	tristate "LED driver for AW2013 RGB LED"
	depends on LEDS_CLASS
	depends on I2C
	help
		This option enables support for AW2013 RGB LED driver chips
		accessed via the I2C bus.
	
config LEDS_KTD
	tristate "LED driver for KTD RGB LED"
	depends on LEDS_CLASS
	depends on I2C
	help
	  This option enables support for KTD RGB LED driver chips
	  accessed via the I2C bus.
```

## coolpad/drivers/misc/Kconfig
```kconfig
#
# Misc strange devices
#

config BOOTREASON
	bool "yulong bootreason"
	default y
	help
	  Yulong bootreason

#added by zhuhui 2014.2.28
config CREATE_NODE
	bool "Call State file Node"
	default n
	help
	  Create Call State file Node Driver.
#added by Eric for uei driver 20160420
config INFRARED_UEI1700
	bool "UEI REMOTE driver"
        default n
        help
          Create uei1700 infrared Driver.
```

## coolpad/drivers/mmc/card/Kconfig
```kconfig
#
# MMC/SD card drivers
#

config MMC_YL_PARAMS
	bool "yl_params.c"
	default n
	help
	  Say Y here to enable deferred MMC resume until I/O
	  is requested. This will reduce overall resume latency and
	  save power when theres an SD card inserted but not being used.
```

## coolpad/drivers/power/Kconfig
```kconfig
config YL_PM8916_VBUS
	tristate "yulong pm8916 vbus driver"
	depends on SPMI
	depends on OF_SPMI
	depends on MSM_QPNP_INT
	depends on THERMAL_QPNP_ADC_TM
	help
	  Say Y here to enable the yulong pm8916 VBUS driver

config YL_FAN5405_CHARGER
	tristate "fan5405 charger driver"
	depends on I2C
	help
	  Say Y here to enable the fan5405 sm charge driver

config YL_BQ24157_CHARGER
	tristate "bq24157 charger driver"
	depends on I2C
	help
	  Say Y here to enable the fan5405 sm charge driver

config YL_LC709203_FUELGAUGE
	tristate "lc709203 fuelgauge driver"
	depends on I2C
	help
	  Say Y here to enable the lc709203 fuelgauge driver

config YL_ADC_BATTERY
	tristate "yulong adc battery driver"
	help
	  Say Y here to enable the yulong adc battery driver

config USE_QC_BMS_BATT_FORMAT
	bool "yulong adc battery driver"
	help
	  Say Y here to use BMS battery format for yl_adc_battery
config PRORITIZE_LOAD_LC709203
	bool "proritize load lc709203 driver"
	help
	  Say Y here to proritize load lc709203

#modify begin by sunxiaogang for codes platform design 2014.12.22
config CHARGE_CONFIG_MICROMAX
        bool "yulong bq24157 charger driver"
        help
          Say Y here to use micromax configs for yl_bq124157_charger
#modify end

config YL_CHARGE_MODE
        bool "select for fast or normal charging"
        default n
        help
          Say Y to enable charge mode.

config YL_BQ25890_CHARGER
       tristate "bq25890 Charger driver"
       depends on I2C
       help
         Say Y here to enable the bq25890 charge driver
```

## coolpad/drivers/regulator/Kconfig
```kconfig
config YL_TPS65132
	default n
	bool "TPS65132 Dual Output Power Supply"
	---help---
	  The TPS65132 is designed to support general positive/negative driven
	  applications. The device uses a single inductor scheme in order to
	  provide the user the smallest solution size possible as well as high
	  efficiency. With its input voltage range of 2.5 V to 5.5 V, it is
	  optimized for products powered by single-cell batteries (Li-Ion,
	  Ni-Li, Li-Polymer) and output currents up to 80 mA.

config YL_TPS65132_5_5
	default n
	bool "YL_TPS65132 5.5v power LCD Supply"
	---help---
	  YL_TPS65132_5_5.
```

## coolpad/drivers/sensors/Kconfig
```kconfig
###########################################
## 	Kconfig for sensors devices	 ##
## 	Author:LongJiang		 ##
## 	Date:2013-09-13			 ##
###########################################

menu "Coolpad Sensors Device Drivers"

config YL_SENSORS_DEBUG
	tristate "Generic sensors debug config" if EXPERT
	default n
	help
	  Say Y here if you want to debug the sensors
	  Say N here if you do not want to debug the sensors

	  If unsure, say Y.

config YL_SENSORS
	tristate "Generic sensor layer (needed for accelerometer, ambient, proximity, ...)" if EXPERT
	default y
	help
	  Say Y here if you have any sensor device (accelerometer, light, proximity,
	  compass, ...) connected to your system and want it to be available to applications.

	  Say N here if you have a headless (no proximity, no compass) system.

	  If unsure, say Y.

if YL_SENSORS

source "coolpad/drivers/sensors/sensparams/Kconfig"

source "coolpad/drivers/sensors/accel/Kconfig"

source "coolpad/drivers/sensors/alsprox/Kconfig"

source "coolpad/drivers/sensors/hall/Kconfig"

source "coolpad/drivers/sensors/remote/Kconfig"

source "coolpad/drivers/sensors/invensense/Kconfig"
endif

endmenu
```

## coolpad/drivers/sensors/accel/Kconfig
```kconfig
############################################
## 	Kconfig for acc sensors devices
## 	Author:LongJiang
## 	Date:2013-09-13
############################################

menu "Sensors Device Drivers"

config YL_SENSORS_GSENSOR
	tristate "Generic sensor layer (needed for BMA250E, KXTJ2-1009, ...)" if EXPERT
	default y
	help
	  Say Y here if you have any sensor device (BMA250E, KXTJ2-1009, ...)
	  connected to your system and want it to be available to applications.

	  Say N here if you have a headless (no BMA250E, no KXTJ2-1009) system.

	  If unsure, say Y.

if YL_SENSORS_GSENSOR

source "coolpad/drivers/sensors/accel/bma2x2/Kconfig"

source "coolpad/drivers/sensors/accel/lis3dh/Kconfig"

source "coolpad/drivers/sensors/accel/kionix/Kconfig"

source "coolpad/drivers/sensors/accel/n2dm/Kconfig"
endif

endmenu
```

## coolpad/drivers/sensors/accel/kionix/Kconfig
```kconfig
############################################
## 	Kconfig for accel sensors devices
## 	Author:LongJiang
## 	Date:2013-09-13
############################################

#
# Miscellaneous I2C chip drivers configuration
#
# *** DEPRECATED! Do not add new entries! See Makefile ***
#

menu "Miscellaneous I2C Chip support"


config YL_KIONIX_ACCELER
	tristate "kinnox acceleration sensor support"
	depends on I2C=y
	help
	  If you say yes here you get support for kionix Sensortec's
	  acceleration sensors kionix.

endmenu
```

## coolpad/drivers/sensors/alsprox/Kconfig
```kconfig
###########################################
## 	Kconfig for alsprox sensors devices
## 	Author:LongJiang
## 	Date:2013-09-13
############################################

menu "alsprox-sensor Device Drivers"

config YL_SENSORS_ALSPROX
	tristate "Generic sensor layer (needed for tmd277x, ltr55x, ...)" if EXPERT
	default y
	help
	  Say Y here if you have any sensor device (tmd277x, ltr55x, ...)
	  connected to your system and want it to be available to applications.

	  Say N here if you have a headless (no tmd277x, no ltr55x) system.

	  If unsure, say Y.

if YL_SENSORS_ALSPROX

source "coolpad/drivers/sensors/alsprox/ltr559/Kconfig"
source "coolpad/drivers/sensors/alsprox/ltr559_2input/Kconfig"
source "coolpad/drivers/sensors/alsprox/ltr558/Kconfig"
source "coolpad/drivers/sensors/alsprox/tmd277x/Kconfig"
source "coolpad/drivers/sensors/alsprox/pa12200001/Kconfig"

endif

endmenu
```

## coolpad/drivers/sensors/alsprox/ltr558/Kconfig
```kconfig
############################################
## 	Kconfig for alsprox sensors devices
## 	Author:LongJiang
## 	Date:2013-09-25
############################################

config YL_LTR558_ALSPROX
	tristate "LTR558 Ambient & Promixity Sensor Driver"
	depends on I2C
	default n
	help
	 LTR558 Ambient & Promixity Sensor Driver implemented by YL.
```

## coolpad/drivers/sensors/alsprox/pa12200001/Kconfig
```kconfig
############################################
## 	Kconfig for alsprox sensors devices	
############################################

config YL_PA12200001_ALSPROX
	tristate "TXC_PA12200001 P/L sensor support"
	default n
	depends on I2C=y
	help
	  If you say yes here you get support for TXC's proximity
	  and light sensors PA12200001.

config YL_PA12200001_ALSPROX_HQ
	tristate "TXC_PA12200001 P/L sensor support"
	default n
	depends on I2C=y
	help
		If you say yes here you get support for TXC's proximity
		and light sensors PA12200001.
```

## coolpad/drivers/sensors/alsprox/tmd277x/Kconfig
```kconfig
############################################
## 	Kconfig for alsprox sensors devices
## 	Author:LongJiang
## 	Date:2013-09-13
############################################

config YL_TMD277X_ALSPROX
	tristate "TAOS Ambient & Promixity Sensor Driver"
	depends on I2C
	default n
	help
	TAOS Ambient & Promixity Sensor Driver implemented by YL.
```

## coolpad/drivers/sensors/invensense/imu/Kconfig
```kconfig
#
# IIO imu drivers configuration
#
menu "Inertial measurement units"

source "coolpad/drivers/sensors/invensense/imu/inv_mpu/Kconfig"

endmenu
```
