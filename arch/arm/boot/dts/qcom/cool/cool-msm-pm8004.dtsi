/* Copyright (c) 2014-2015, The Linux Foundation. All rights reserved.
 *
 * This program is free software; you can redistribute it and/or modify
 * it under the terms of the GNU General Public License version 2 and
 * only version 2 as published by the Free Software Foundation.
 *
 * This program is distributed in the hope that it will be useful,
 * but WITHOUT ANY WARRANTY; without even the implied warranty of
 * MERCHANTABILITY or FITNESS FOR A PARTICULAR PURPOSE.  See the
 * GNU General Public License for more details.
 */

&spmi_bus {
	qcom,pm8004@4 {
			mpp@a100 {
				status = "okay";
				qcom,mode = <6>; /* Current Sink */
				qcom,invert = <0>; /* Disable invert */
				qcom,src-sel = <4>; /* DTEST1 */
				qcom,cs-out= <7>; /* output to sync*/
				qcom,master-en = <1>; /* Enable MPP */
			};
	   };
};
