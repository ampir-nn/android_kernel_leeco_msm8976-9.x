#include "cool-msm8976.dtsi"
#include "cool-msm8976-pinctrl.dtsi"
#include "cool-msm8976-mtp.dtsi"
#include "cool-msm8976-mdss.dtsi"
#include "cool-msm8976-mdss-panels.dtsi"
#include "cool-msm8976-mdss-mtp.dtsi"
#include "cool-msm-pm8950.dtsi"
#include "cool-msm-pmi8950.dtsi"
#include "cool-msm8976-regulator.dtsi"
#include "cool-msm-pm8950-rpm-regulator.dtsi"
#include "cool-msm8976-wsa881x.dtsi"
#include "cool-msm-pm8004.dtsi"
#include "msm8976-internal-codec-mtp.dtsi"
#include "cool-msm8976-camera-sensor-mtp.dtsi"
// #include "cool-system-mount.dtsi"
