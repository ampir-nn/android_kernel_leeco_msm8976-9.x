/*
 * Copyright (c) 2015, The Linux Foundation. All rights reserved.
 *
 * This program is free software; you can redistribute it and/or modify
 * it under the terms of the GNU General Public License version 2 and
 * only version 2 as published by the Free Software Foundation.
 *
 * This program is distributed in the hope that it will be useful,
 * but WITHOUT ANY WARRANTY; without even the implied warranty of
 * MERCHANTABILITY or FITNESS FOR A PARTICULAR PURPOSE.  See the
 * GNU General Public License for more details.
 */

&rpm_bus {
	rpm-regulator-smpa1 {
		status = "okay";

		regulator-s1 {
			status = "okay";
			regulator-min-microvolt = <1000000>;
			regulator-max-microvolt = <1162500>;
			qcom,init-voltage = <1000000>;
			linux,phandle = <0x15e>;
			phandle = <0x15e>;

		};
	};
};
