
qcom,yulong_batterydata_cpld403_coslight_4000mah{
	qcom,max-voltage-uv = <4400000>;
	qcom,nom-batt-capacity-mah = <4100>;
	qcom,batt-id-kohm = <10>;
	qcom,battery-beta = <3435>;
	qcom,battery-type = "yulong_batterydata_cpld403_coslight_4000mah";
	qcom,chg-rslow-comp-c1 = <4183293>;
	qcom,chg-rslow-comp-c2 = <7062633>;
	qcom,chg-rs-to-rslow = <879256>;
	qcom,chg-rslow-comp-thr = <0xB4>;
	qcom,checksum = <0x7C04>;
	qcom,gui-version = "PMI8950GUI - 2.0.0.16";
	qcom,fg-profile-data = [
		 DC 83 A0 7C
		 D9 80 B5 76
		 5B 83 10 67
		 DB 83 FA 8E
		 66 82 2D 98
		 0C B6 E2 C1
		 52 13 F7 83
		 F8 7C E2 80
		 72 76 4F 83
		 6C 70 05 70
		 83 84 53 82
		 8B 99 CE BC
		 A2 C9 58 0D
		 47 10 E0 5A
		 14 70 DA FC
		 D9 37 B7 46
		 FE 42 00 00
		 74 46 50 32
		 5F 38 00 00
		 00 00 00 00
		 00 00 00 00
		 93 6B 33 69
		 FC 5F 4D 89
		 DE 7C 74 72
		 D9 44 67 80
		 34 76 2E 6B
		 E8 74 E0 A8
		 24 67 5A 94
		 57 A0 71 0C
		 28 00 FF 36
		 F0 11 30 03
		 00 00 00 0C
	];
};
