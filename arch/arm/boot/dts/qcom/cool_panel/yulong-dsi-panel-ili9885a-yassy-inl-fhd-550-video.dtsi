/* Copyright (c) 2014, The Linux Foundation. All rights reserved.
 *
 * This program is free software; you can redistribute it and/or modify
 * it under the terms of the GNU General Public License version 2 and
 * only version 2 as published by the Free Software Foundation.
 *
 * This program is distributed in the hope that it will be useful,
 * but WITHOUT ANY WARRANTY; without even the implied warranty of
 * MERCHANTABILITY or FITNESS FOR A PARTICULAR PURPOSE.  See the
 * GNU General Public License for more details.
 */

/*---------------------------------------------------------------------------
 * This file is autogenerated file using gcdb parser. Please do not edit it.
 * Update input XML file to add a new entry or update variable in this file
 * VERSION = "1.0"
 *---------------------------------------------------------------------------*/
 
&mdss_mdp {
	dsi_ili9885a_yassy_inl_fhd_vid: qcom,mdss_dsi_ili9885a_yassy_inl_fhd_video {
		qcom,cont-splash-enabled;
		qcom,mdss-dsi-panel-name = "LCD_TYPE_ILI9885A_YASSY_INL_FHD_550";
		qcom,mdss-dsi-panel-type = "dsi_video_mode";
		qcom,mdss-dsi-panel-framerate = <60>;
		qcom,mdss-dsi-virtual-channel-id = <0>;
		qcom,mdss-dsi-stream = <0>;
		qcom,mdss-dsi-panel-width = <1080>;
		qcom,mdss-dsi-panel-height = <1920>;
		qcom,mdss-dsi-h-front-porch = <80>;
		qcom,mdss-dsi-h-back-porch = <80>;
		qcom,mdss-dsi-h-pulse-width = <18>;
		qcom,mdss-dsi-h-sync-skew = <0>;
		qcom,mdss-dsi-v-back-porch = <24>;
		qcom,mdss-dsi-v-front-porch = <32>;
		qcom,mdss-dsi-v-pulse-width = <8>;
		qcom,mdss-dsi-h-left-border = <0>;
		qcom,mdss-dsi-h-right-border = <0>;
		qcom,mdss-dsi-v-top-border = <0>;
		qcom,mdss-dsi-v-bottom-border = <0>;
		qcom,mdss-dsi-bpp = <24>;
		qcom,mdss-dsi-underflow-color = <0xff>;
		qcom,mdss-dsi-border-color = <0>;
		qcom,mdss-dsi-pixel-packing = <0>;
		qcom,mdss-dsi-on-command = [
			39 01 00 00 14 00 04 B0 98 85 0A
                        39 01 00 00 00 00 07 D0 44 05 23 70 67 C0
                        39 01 00 00 00 00 03 D1 0A 0A
                        39 01 00 00 00 00 05 D2 13 13 EA 22
                        39 01 00 00 00 00 0A D3 33 33 05 03 7C 7C 88 2B 22
                        39 01 00 00 00 00 08 EC 76 1E 32 00 46 00 02
                        39 01 00 00 00 00 09 EF 3C 05 52 13 e1 33 5b 09
                        39 01 00 00 00 00 0D D6 00 00 08 17 23 65 77 44 87 00 00 09
                        39 01 00 00 00 00 4A E5 F6 F6 F6 A8 F6 18 0A 5C 4E 38 2A F6 F6 5B 64 8C 36 36 36 C8 F6 F6 F6 A1 F6 11 03 55 47 31 23 F6 F6 5B 64 85 36 36 36 C1 0e 40 70 00 00 00 40 04 00 01 01 24 00 00 00 00 00 00 00 00 00 00 00 00 00 13 13 13 13 13 13 00 07
                        39 01 00 00 00 00 43 EA 51 13 00 00 00 00 00 40 00 00 00 00 00 00 0d 00 00 00 00 00 00 00 00 0f 03 00 00 00 3c 70 01 21 00 40 80 c0 00 00 01 23 45 67 89 ab cd ef 33 33 33 22 33 00 00 00 00 11 11 33 33 DD DD 22 CC CC CC 33
                        39 01 00 00 00 00 18 ED 00 01 00 00 00 00 00 00 00 00 00 00 00 00 00 00 00 00 00 00 00 00 40
                        39 01 00 00 00 00 14 EE 22 10 02 02 0F 40 00 07 00 04 00 00 C0 B9 77 00 55 05 1F
                        39 01 00 00 00 00 21 EB A3 CF 66 18 54 55 55 55 55 50 A9 6A 55 AA 56 25 0D 0F 00 00 00 00 00 55 55 55 55 32 3E 55 43 55
                        39 01 00 00 00 00 7B C7 00 CD 00 D9 00 EE 01 00 01 10 01 1F 01 2C 01 38 01 43 01 68 01 86 01 B6 01 DA 02 10 02 3D 02 3E 02 69 02 9A 02 BC 02 E9 03 08 03 31 03 3E 03 4D 03 5D 03 6F 03 85 03 A7 03 D1 03 E6 00 CD 00 D9 00 EE 01 00 01 10 01 1F 01 2C 01 38 01 43 01 68 01 86 01 B6 01 DA 02 10 02 3D 02 3E 02 69 02 9A 02 BC 02 E9 03 08 03 31 03 3E 03 4D 03 5D 03 6F 03 85 03 A7 03 D1 03 E6 01 01
                        05 01 00 00 78 00 02 11 00
                        39 01 00 00 00 00 02 F5 85
                        39 01 00 00 00 00 02 BA 04
                        39 01 00 00 00 00 02 F5 00
                        05 01 00 00 14 00 02 29 00
                        39 01 00 00 00 00 02 B0 11
	];
		qcom,mdss-dsi-off-command = [05 01 00 00 32 00 02 28 00
				 05 01 00 00 78 00 02 10 00];
		qcom,mdss-dsi-on-command-state = "dsi_lp_mode";
		qcom,mdss-dsi-off-command-state = "dsi_lp_mode";
		/* esd start */
		qcom,esd-check-enabled;
		qcom,mdss-dsi-panel-status-value = <0x9C>;
		qcom,mdss-dsi-panel-status-read-length = <1>;
		qcom,mdss-dsi-panel-status-command = [06 01 00 01 05 00 02 0A 08];
		qcom,mdss-dsi-panel-status-command-state = "dsi_lp_mode";
		qcom,mdss-dsi-panel-status-check-mode = "reg_read";
		/* esd end */
		qcom,mdss-dsi-h-sync-pulse = <1>;
		qcom,mdss-dsi-traffic-mode = "burst_mode";
		qcom,mdss-dsi-bllp-eof-power-mode;
		qcom,mdss-dsi-bllp-power-mode;
		qcom,mdss-dsi-lane-0-state;
		qcom,mdss-dsi-lane-1-state;
		qcom,mdss-dsi-lane-2-state;
		qcom,mdss-dsi-lane-3-state;
		qcom,mdss-dsi-panel-timings = [E6 38 26 00 68 6E 2A 3C 2C 03 04 00];
		qcom,mdss-dsi-t-clk-post = <0x02>;
		qcom,mdss-dsi-t-clk-pre = <0x2B>;
		qcom,mdss-dsi-bl-min-level = <1>;
		qcom,mdss-dsi-bl-max-level = <4095>;
		qcom,mdss-dsi-dma-trigger = "trigger_sw";
		qcom,mdss-dsi-mdp-trigger = "none";
		qcom,mdss-dsi-bl-pmic-control-type = "bl_ctrl_wled";
		qcom,mdss-dsi-reset-sequence = <1 20>, <0 10>, <1 20>;
		qcom,mdss-pan-physical-width-dimension = <68>;
		qcom,mdss-pan-physical-height-dimension = <121>;
		qcom,mdss-dsi-lp11-init;
		qcom,mdss-dsi-init-delay-us = <5>;
		qcom,mdss-dsi-post-init-delay = <5>;
		qcom,mdss-dsi-avdd-avee-enabled;
		qcom,mdss-dsi-avdd-init-lcd-voltage = <5500000>;
		qcom,mdss-dsi-avee-init-lcd-voltage = <5500000>;
	};
};
