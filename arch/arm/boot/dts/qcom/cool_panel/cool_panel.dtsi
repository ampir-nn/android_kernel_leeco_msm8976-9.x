#include "yulong-dsi-panel-hx8398a-by-auo-fhd-550-video.dtsi"
#include "yulong-dsi-panel-ili9885-lide-auo-fhd-550-video.dtsi"
#include "yulong-dsi-panel-ili9885a-yassy-inl-fhd-550-video.dtsi"
#include "yulong-dsi-panel-nt35532-boyi-auo-fhd-550-video.dtsi"
#include "yulong-dsi-panel-nt35532-boyi-hcg-auo-fhd-550-video.dtsi"
#include "yulong-dsi-panel-nt35532-each-auo-fhd-550-video.dtsi"
