/* Copyright (c) 2014, The Linux Foundation. All rights reserved.
 *
 * This program is free software; you can redistribute it and/or modify
 * it under the terms of the GNU General Public License version 2 and
 * only version 2 as published by the Free Software Foundation.
 *
 * This program is distributed in the hope that it will be useful,
 * but WITHOUT ANY WARRANTY; without even the implied warranty of
 * MERCHANTABILITY or FITNESS FOR A PARTICULAR PURPOSE.  See the
 * GNU General Public License for more details.
 */

/*---------------------------------------------------------------------------
 * This file is autogenerated file using gcdb parser. Please do not edit it.
 * Update input XML file to add a new entry or update variable in this file
 * VERSION = "1.0"
 *---------------------------------------------------------------------------*/

&mdss_mdp {
	dsi_nt35532_boyi_hcg_auo_fhd_vid: qcom,mdss_dsi_nt35532_boyi_hcg_auo_fhd_video {
		qcom,cont-splash-enabled;
		qcom,mdss-dsi-panel-name = "LCD_TYPE_NT35532_BOYI_HCG_AUO_FHD_550";
		qcom,mdss-dsi-panel-type = "dsi_video_mode";
		qcom,mdss-dsi-panel-framerate = <60>;
		qcom,mdss-dsi-virtual-channel-id = <0>;
		qcom,mdss-dsi-stream = <0>;
		qcom,mdss-dsi-panel-width = <1080>;
		qcom,mdss-dsi-panel-height = <1920>;
		qcom,mdss-dsi-h-front-porch = <96>;
		qcom,mdss-dsi-h-back-porch = <80>;
		qcom,mdss-dsi-h-pulse-width = <20>;
		qcom,mdss-dsi-h-sync-skew = <0>;
		qcom,mdss-dsi-v-back-porch = <16>;
		qcom,mdss-dsi-v-front-porch = <16>;
		qcom,mdss-dsi-v-pulse-width = <5>;
		qcom,mdss-dsi-h-left-border = <0>;
		qcom,mdss-dsi-h-right-border = <0>;
		qcom,mdss-dsi-v-top-border = <0>;
		qcom,mdss-dsi-v-bottom-border = <0>;
		qcom,mdss-dsi-bpp = <24>;
		qcom,mdss-dsi-underflow-color = <0xff>;
		qcom,mdss-dsi-border-color = <0>;
		qcom,mdss-dsi-pixel-packing = <0>;
		qcom,mdss-dsi-on-command = [
			23 01 00 00 00 00 02 FF 01
			23 01 00 00 00 00 02 FB 01
			23 01 00 00 00 00 02 00 01
			23 01 00 00 00 00 02 01 55
			23 01 00 00 00 00 02 02 59
			23 01 00 00 00 00 02 04 0C
			23 01 00 00 00 00 02 05 2B
			23 01 00 00 00 00 02 06 64
			23 01 00 00 00 00 02 07 C6
			23 01 00 00 00 00 02 0D 89
			23 01 00 00 00 00 02 0E 89
			23 01 00 00 00 00 02 0F E0
			23 01 00 00 00 00 02 10 03
			23 01 00 00 00 00 02 11 5A
			23 01 00 00 00 00 02 12 5A
			/* 0X7E */
			23 01 00 00 00 00 02 13 85
			23 01 00 00 00 00 02 14 85
			23 01 00 00 00 00 02 15 60
			23 01 00 00 00 00 02 16 13
			23 01 00 00 00 00 02 17 13
			23 01 00 00 00 00 02 1C A3
			23 01 00 00 00 00 02 60 77

			/* Start Gamma */
			//page selection cmd start
			23 01 00 00 00 00 02 FF 01
			23 01 00 00 00 00 02 FB 01
			//page selection cmd end
			//R(+) MCR cmd
			23 01 00 00 00 00 02 75 00
			23 01 00 00 00 00 02 76 48
			23 01 00 00 00 00 02 77 00
			23 01 00 00 00 00 02 78 7A
			23 01 00 00 00 00 02 79 00
			23 01 00 00 00 00 02 7A A7
			23 01 00 00 00 00 02 7B 00
			23 01 00 00 00 00 02 7C C5
			23 01 00 00 00 00 02 7D 00
			23 01 00 00 00 00 02 7E DC
			23 01 00 00 00 00 02 7F 00
			23 01 00 00 00 00 02 80 F0
			23 01 00 00 00 00 02 81 01
			23 01 00 00 00 00 02 82 01
			23 01 00 00 00 00 02 83 01
			23 01 00 00 00 00 02 84 10
			23 01 00 00 00 00 02 85 01
			23 01 00 00 00 00 02 86 1D
			23 01 00 00 00 00 02 87 01
			23 01 00 00 00 00 02 88 4A
			23 01 00 00 00 00 02 89 01
			23 01 00 00 00 00 02 8A 6D
			23 01 00 00 00 00 02 8B 01
			23 01 00 00 00 00 02 8C A5
			23 01 00 00 00 00 02 8D 01
			23 01 00 00 00 00 02 8E D0
			23 01 00 00 00 00 02 8F 02
			23 01 00 00 00 00 02 90 13
			23 01 00 00 00 00 02 91 02
			23 01 00 00 00 00 02 92 4A
			23 01 00 00 00 00 02 93 02
			23 01 00 00 00 00 02 94 4B
			23 01 00 00 00 00 02 95 02
			23 01 00 00 00 00 02 96 7D
			23 01 00 00 00 00 02 97 02
			23 01 00 00 00 00 02 98 B6
			23 01 00 00 00 00 02 99 02
			23 01 00 00 00 00 02 9A DA
			23 01 00 00 00 00 02 9B 03
			23 01 00 00 00 00 02 9C 08
			23 01 00 00 00 00 02 9D 03
			23 01 00 00 00 00 02 9E 26
			23 01 00 00 00 00 02 9F 03
			23 01 00 00 00 00 02 A0 4C
			23 01 00 00 00 00 02 A2 03
			23 01 00 00 00 00 02 A3 56
			23 01 00 00 00 00 02 A4 03
			23 01 00 00 00 00 02 A5 66
			23 01 00 00 00 00 02 A6 03
			23 01 00 00 00 00 02 A7 76
			23 01 00 00 00 00 02 A9 03
			23 01 00 00 00 00 02 AA 88
			23 01 00 00 00 00 02 AB 03
			23 01 00 00 00 00 02 AC 9C
			23 01 00 00 00 00 02 AD 03
			23 01 00 00 00 00 02 AE AF
			23 01 00 00 00 00 02 AF 03
			23 01 00 00 00 00 02 B0 EF
			23 01 00 00 00 00 02 B1 03
			23 01 00 00 00 00 02 B2 FF
			//R(-) MCR cmd
			23 01 00 00 00 00 02 B3 00
			23 01 00 00 00 00 02 B4 48
			23 01 00 00 00 00 02 B5 00
			23 01 00 00 00 00 02 B6 7A
			23 01 00 00 00 00 02 B7 00
			23 01 00 00 00 00 02 B8 A7
			23 01 00 00 00 00 02 B9 00
			23 01 00 00 00 00 02 BA C5
			23 01 00 00 00 00 02 BB 00
			23 01 00 00 00 00 02 BC DC
			23 01 00 00 00 00 02 BD 00
			23 01 00 00 00 00 02 BE F0
			23 01 00 00 00 00 02 BF 01
			23 01 00 00 00 00 02 C0 01
			23 01 00 00 00 00 02 C1 01
			23 01 00 00 00 00 02 C2 10
			23 01 00 00 00 00 02 C3 01
			23 01 00 00 00 00 02 C4 1D
			23 01 00 00 00 00 02 C5 01
			23 01 00 00 00 00 02 C6 4A
			23 01 00 00 00 00 02 C7 01
			23 01 00 00 00 00 02 C8 6D
			23 01 00 00 00 00 02 C9 01
			23 01 00 00 00 00 02 CA A5
			23 01 00 00 00 00 02 CB 01
			23 01 00 00 00 00 02 CC D0
			23 01 00 00 00 00 02 CD 02
			23 01 00 00 00 00 02 CE 13
			23 01 00 00 00 00 02 CF 02
			23 01 00 00 00 00 02 D0 4A
			23 01 00 00 00 00 02 D1 02
			23 01 00 00 00 00 02 D2 4B
			23 01 00 00 00 00 02 D3 02
			23 01 00 00 00 00 02 D4 7D
			23 01 00 00 00 00 02 D5 02
			23 01 00 00 00 00 02 D6 B6
			23 01 00 00 00 00 02 D7 02
			23 01 00 00 00 00 02 D8 DA
			23 01 00 00 00 00 02 D9 03
			23 01 00 00 00 00 02 DA 08
			23 01 00 00 00 00 02 DB 03
			23 01 00 00 00 00 02 DC 26
			23 01 00 00 00 00 02 DD 03
			23 01 00 00 00 00 02 DE 4C
			23 01 00 00 00 00 02 DF 03
			23 01 00 00 00 00 02 E0 56
			23 01 00 00 00 00 02 E1 03
			23 01 00 00 00 00 02 E2 66
			23 01 00 00 00 00 02 E3 03
			23 01 00 00 00 00 02 E4 76
			23 01 00 00 00 00 02 E5 03
			23 01 00 00 00 00 02 E6 88
			23 01 00 00 00 00 02 E7 03
			23 01 00 00 00 00 02 E8 9C
			23 01 00 00 00 00 02 E9 03
			23 01 00 00 00 00 02 EA AF
			23 01 00 00 00 00 02 EB 03
			23 01 00 00 00 00 02 EC EF
			23 01 00 00 00 00 02 ED 03
			23 01 00 00 00 00 02 EE FF
			//G(+) MCR cmd
			23 01 00 00 00 00 02 EF 00
			23 01 00 00 00 00 02 F0 49
			23 01 00 00 00 00 02 F1 00
			23 01 00 00 00 00 02 F2 78
			23 01 00 00 00 00 02 F3 00
			23 01 00 00 00 00 02 F4 A8
			23 01 00 00 00 00 02 F5 00
			23 01 00 00 00 00 02 F6 C5
			23 01 00 00 00 00 02 F7 00
			23 01 00 00 00 00 02 F8 DE
			23 01 00 00 00 00 02 F9 00
			23 01 00 00 00 00 02 FA EF
			//page selection cmd start
			23 01 00 00 00 00 02 FF 02
			23 01 00 00 00 00 02 FB 01
			//page selection cmd end
			23 01 00 00 00 00 02 00 01
			23 01 00 00 00 00 02 01 04
			23 01 00 00 00 00 02 02 01
			23 01 00 00 00 00 02 03 12
			23 01 00 00 00 00 02 04 01
			23 01 00 00 00 00 02 05 1D
			23 01 00 00 00 00 02 06 01
			23 01 00 00 00 00 02 07 4E
			23 01 00 00 00 00 02 08 01
			23 01 00 00 00 00 02 09 72
			23 01 00 00 00 00 02 0A 01
			23 01 00 00 00 00 02 0B AA
			23 01 00 00 00 00 02 0C 01
			23 01 00 00 00 00 02 0D D4
			23 01 00 00 00 00 02 0E 02
			23 01 00 00 00 00 02 0F 17
			23 01 00 00 00 00 02 10 02
			23 01 00 00 00 00 02 11 4D
			23 01 00 00 00 00 02 12 02
			23 01 00 00 00 00 02 13 4E
			23 01 00 00 00 00 02 14 02
			23 01 00 00 00 00 02 15 80
			23 01 00 00 00 00 02 16 02
			23 01 00 00 00 00 02 17 B7
			23 01 00 00 00 00 02 18 02
			23 01 00 00 00 00 02 19 DB
			23 01 00 00 00 00 02 1A 03
			23 01 00 00 00 00 02 1B 0A
			23 01 00 00 00 00 02 1C 03
			23 01 00 00 00 00 02 1D 28
			23 01 00 00 00 00 02 1E 03
			23 01 00 00 00 00 02 1F 50
			23 01 00 00 00 00 02 20 03
			23 01 00 00 00 00 02 21 5B
			23 01 00 00 00 00 02 22 03
			23 01 00 00 00 00 02 23 68
			23 01 00 00 00 00 02 24 03
			23 01 00 00 00 00 02 25 79
			23 01 00 00 00 00 02 26 03
			23 01 00 00 00 00 02 27 8C
			23 01 00 00 00 00 02 28 03
			23 01 00 00 00 00 02 29 9B
			23 01 00 00 00 00 02 2A 03
			23 01 00 00 00 00 02 2B AD
			23 01 00 00 00 00 02 2D 03
			23 01 00 00 00 00 02 2F C2
			23 01 00 00 00 00 02 30 03
			23 01 00 00 00 00 02 31 FF
			//G(-) MCR cmd
			23 01 00 00 00 00 02 32 00
			23 01 00 00 00 00 02 33 49
			23 01 00 00 00 00 02 34 00
			23 01 00 00 00 00 02 35 78
			23 01 00 00 00 00 02 36 00
			23 01 00 00 00 00 02 37 A8
			23 01 00 00 00 00 02 38 00
			23 01 00 00 00 00 02 39 C5
			23 01 00 00 00 00 02 3A 00
			23 01 00 00 00 00 02 3B DE
			23 01 00 00 00 00 02 3D 00
			23 01 00 00 00 00 02 3F EF
			23 01 00 00 00 00 02 40 01
			23 01 00 00 00 00 02 41 04
			23 01 00 00 00 00 02 42 01
			23 01 00 00 00 00 02 43 12
			23 01 00 00 00 00 02 44 01
			23 01 00 00 00 00 02 45 1D
			23 01 00 00 00 00 02 46 01
			23 01 00 00 00 00 02 47 4E
			23 01 00 00 00 00 02 48 01
			23 01 00 00 00 00 02 49 72
			23 01 00 00 00 00 02 4A 01
			23 01 00 00 00 00 02 4B AA
			23 01 00 00 00 00 02 4C 01
			23 01 00 00 00 00 02 4D D4
			23 01 00 00 00 00 02 4E 02
			23 01 00 00 00 00 02 4F 17
			23 01 00 00 00 00 02 50 02
			23 01 00 00 00 00 02 51 4D
			23 01 00 00 00 00 02 52 02
			23 01 00 00 00 00 02 53 4E
			23 01 00 00 00 00 02 54 02
			23 01 00 00 00 00 02 55 80
			23 01 00 00 00 00 02 56 02
			23 01 00 00 00 00 02 58 B7
			23 01 00 00 00 00 02 59 02
			23 01 00 00 00 00 02 5A DB
			23 01 00 00 00 00 02 5B 03
			23 01 00 00 00 00 02 5C 0A
			23 01 00 00 00 00 02 5D 03
			23 01 00 00 00 00 02 5E 28
			23 01 00 00 00 00 02 5F 03
			23 01 00 00 00 00 02 60 50
			23 01 00 00 00 00 02 61 03
			23 01 00 00 00 00 02 62 5B
			23 01 00 00 00 00 02 63 03
			23 01 00 00 00 00 02 64 68
			23 01 00 00 00 00 02 65 03
			23 01 00 00 00 00 02 66 79
			23 01 00 00 00 00 02 67 03
			23 01 00 00 00 00 02 68 8C
			23 01 00 00 00 00 02 69 03
			23 01 00 00 00 00 02 6A 9B
			23 01 00 00 00 00 02 6B 03
			23 01 00 00 00 00 02 6C AD
			23 01 00 00 00 00 02 6D 03
			23 01 00 00 00 00 02 6E C2
			23 01 00 00 00 00 02 6F 03
			23 01 00 00 00 00 02 70 FF
			//B(+) MCR cmd
			23 01 00 00 00 00 02 71 00
			23 01 00 00 00 00 02 72 C1
			23 01 00 00 00 00 02 73 00
			23 01 00 00 00 00 02 74 CC
			23 01 00 00 00 00 02 75 00
			23 01 00 00 00 00 02 76 E1
			23 01 00 00 00 00 02 77 00
			23 01 00 00 00 00 02 78 F1
			23 01 00 00 00 00 02 79 01
			23 01 00 00 00 00 02 7A 01
			23 01 00 00 00 00 02 7B 01
			23 01 00 00 00 00 02 7C 0D
			23 01 00 00 00 00 02 7D 01
			23 01 00 00 00 00 02 7E 1C
			23 01 00 00 00 00 02 7F 01
			23 01 00 00 00 00 02 80 27
			23 01 00 00 00 00 02 81 01
			23 01 00 00 00 00 02 82 31
			23 01 00 00 00 00 02 83 01
			23 01 00 00 00 00 02 84 59
			23 01 00 00 00 00 02 85 01
			23 01 00 00 00 00 02 86 7A
			23 01 00 00 00 00 02 87 01
			23 01 00 00 00 00 02 88 AE
			23 01 00 00 00 00 02 89 01
			23 01 00 00 00 00 02 8A D6
			23 01 00 00 00 00 02 8B 02
			23 01 00 00 00 00 02 8C 18
			23 01 00 00 00 00 02 8D 02
			23 01 00 00 00 00 02 8E 4E
			23 01 00 00 00 00 02 8F 02
			23 01 00 00 00 00 02 90 4F
			23 01 00 00 00 00 02 91 02
			23 01 00 00 00 00 02 92 81
			23 01 00 00 00 00 02 93 02
			23 01 00 00 00 00 02 94 B8
			23 01 00 00 00 00 02 95 02
			23 01 00 00 00 00 02 96 DE
			23 01 00 00 00 00 02 97 03
			23 01 00 00 00 00 02 98 11
			23 01 00 00 00 00 02 99 03
			23 01 00 00 00 00 02 9A 37
			23 01 00 00 00 00 02 9B 03
			23 01 00 00 00 00 02 9C 84
			23 01 00 00 00 00 02 9D 03
			23 01 00 00 00 00 02 9E 8E
			23 01 00 00 00 00 02 9F 03
			23 01 00 00 00 00 02 A0 92
			23 01 00 00 00 00 02 A2 03
			23 01 00 00 00 00 02 A3 94
			23 01 00 00 00 00 02 A4 03
			23 01 00 00 00 00 02 A5 96
			23 01 00 00 00 00 02 A6 03
			23 01 00 00 00 00 02 A7 9A
			23 01 00 00 00 00 02 A9 03
			23 01 00 00 00 00 02 AA B5
			23 01 00 00 00 00 02 AB 03
			23 01 00 00 00 00 02 AC F0
			23 01 00 00 00 00 02 AD 03
			23 01 00 00 00 00 02 AE FF
			//B(-) MCR cmd
			23 01 00 00 00 00 02 AF 00
			23 01 00 00 00 00 02 B0 C1
			23 01 00 00 00 00 02 B1 00
			23 01 00 00 00 00 02 B2 CC
			23 01 00 00 00 00 02 B3 00
			23 01 00 00 00 00 02 B4 E1
			23 01 00 00 00 00 02 B5 00
			23 01 00 00 00 00 02 B6 F1
			23 01 00 00 00 00 02 B7 01
			23 01 00 00 00 00 02 B8 01
			23 01 00 00 00 00 02 B9 01
			23 01 00 00 00 00 02 BA 0D
			23 01 00 00 00 00 02 BB 01
			23 01 00 00 00 00 02 BC 1C
			23 01 00 00 00 00 02 BD 01
			23 01 00 00 00 00 02 BE 27
			23 01 00 00 00 00 02 BF 01
			23 01 00 00 00 00 02 C0 31
			23 01 00 00 00 00 02 C1 01
			23 01 00 00 00 00 02 C2 59
			23 01 00 00 00 00 02 C3 01
			23 01 00 00 00 00 02 C4 7A
			23 01 00 00 00 00 02 C5 01
			23 01 00 00 00 00 02 C6 AE
			23 01 00 00 00 00 02 C7 01
			23 01 00 00 00 00 02 C8 D6
			23 01 00 00 00 00 02 C9 02
			23 01 00 00 00 00 02 CA 18
			23 01 00 00 00 00 02 CB 02
			23 01 00 00 00 00 02 CC 4E
			23 01 00 00 00 00 02 CD 02
			23 01 00 00 00 00 02 CE 4F
			23 01 00 00 00 00 02 CF 02
			23 01 00 00 00 00 02 D0 81
			23 01 00 00 00 00 02 D1 02
			23 01 00 00 00 00 02 D2 B8
			23 01 00 00 00 00 02 D3 02
			23 01 00 00 00 00 02 D4 DE
			23 01 00 00 00 00 02 D5 03
			23 01 00 00 00 00 02 D6 11
			23 01 00 00 00 00 02 D7 03
			23 01 00 00 00 00 02 D8 37
			23 01 00 00 00 00 02 D9 03
			23 01 00 00 00 00 02 DA 84
			23 01 00 00 00 00 02 DB 03
			23 01 00 00 00 00 02 DC 8E
			23 01 00 00 00 00 02 DD 03
			23 01 00 00 00 00 02 DE 92
			23 01 00 00 00 00 02 DF 03
			23 01 00 00 00 00 02 E0 94
			23 01 00 00 00 00 02 E1 03
			23 01 00 00 00 00 02 E2 96
			23 01 00 00 00 00 02 E3 03
			23 01 00 00 00 00 02 E4 9A
			23 01 00 00 00 00 02 E5 03
			23 01 00 00 00 00 02 E6 B5
			23 01 00 00 00 00 02 E7 03
			23 01 00 00 00 00 02 E8 F0
			23 01 00 00 00 00 02 E9 03
			23 01 00 00 00 00 02 EA FF
			/* End Gamma */
			23 01 00 00 00 00 02 FF 05
			23 01 00 00 00 00 02 FB 01
			23 01 00 00 00 00 02 00 38
			23 01 00 00 00 00 02 01 38
			23 01 00 00 00 00 02 02 07
			23 01 00 00 00 00 02 03 40
			23 01 00 00 00 00 02 04 40
			23 01 00 00 00 00 02 05 25
			23 01 00 00 00 00 02 06 1D
			23 01 00 00 00 00 02 07 23
			23 01 00 00 00 00 02 08 1B
			23 01 00 00 00 00 02 09 21
			23 01 00 00 00 00 02 0A 19
			23 01 00 00 00 00 02 0B 1F
			23 01 00 00 00 00 02 0C 17
			23 01 00 00 00 00 02 0D 05
			23 01 00 00 00 00 02 0E 04
			23 01 00 00 00 00 02 0F 0F
			23 01 00 00 00 00 02 10 38
			23 01 00 00 00 00 02 11 38
			23 01 00 00 00 00 02 12 38
			23 01 00 00 00 00 02 13 38
			23 01 00 00 00 00 02 14 38
			23 01 00 00 00 00 02 15 38
			23 01 00 00 00 00 02 16 06
			23 01 00 00 00 00 02 17 40
			23 01 00 00 00 00 02 18 40
			23 01 00 00 00 00 02 19 24
			23 01 00 00 00 00 02 1A 1C
			23 01 00 00 00 00 02 1B 22
			23 01 00 00 00 00 02 1C 1A
			23 01 00 00 00 00 02 1D 20
			23 01 00 00 00 00 02 1E 18
			23 01 00 00 00 00 02 1F 1E
			23 01 00 00 00 00 02 20 16
			23 01 00 00 00 00 02 21 05
			23 01 00 00 00 00 02 22 04
			23 01 00 00 00 00 02 23 0E
			23 01 00 00 00 00 02 24 38
			23 01 00 00 00 00 02 25 38
			23 01 00 00 00 00 02 26 38
			23 01 00 00 00 00 02 27 38
			23 01 00 00 00 00 02 28 38
			23 01 00 00 00 00 02 29 38
			23 01 00 00 00 00 02 2A 0E
			23 01 00 00 00 00 02 2B 40
			23 01 00 00 00 00 02 2D 40
			23 01 00 00 00 00 02 2F 16
			23 01 00 00 00 00 02 30 1E
			23 01 00 00 00 00 02 31 18
			23 01 00 00 00 00 02 32 20
			23 01 00 00 00 00 02 33 1A
			23 01 00 00 00 00 02 34 22
			23 01 00 00 00 00 02 35 1C
			23 01 00 00 00 00 02 36 24
			23 01 00 00 00 00 02 37 05
			23 01 00 00 00 00 02 38 04
			23 01 00 00 00 00 02 39 06
			23 01 00 00 00 00 02 3A 38
			23 01 00 00 00 00 02 3B 38
			23 01 00 00 00 00 02 3D 38
			23 01 00 00 00 00 02 3F 38
			23 01 00 00 00 00 02 40 38
			23 01 00 00 00 00 02 41 38
			23 01 00 00 00 00 02 42 0F
			23 01 00 00 00 00 02 43 40
			23 01 00 00 00 00 02 44 40
			23 01 00 00 00 00 02 45 17
			23 01 00 00 00 00 02 46 1F
			23 01 00 00 00 00 02 47 19
			23 01 00 00 00 00 02 48 21
			23 01 00 00 00 00 02 49 1B
			23 01 00 00 00 00 02 4A 23
			23 01 00 00 00 00 02 4B 1D
			23 01 00 00 00 00 02 4C 25
			23 01 00 00 00 00 02 4D 05
			23 01 00 00 00 00 02 4E 04
			23 01 00 00 00 00 02 4F 07
			23 01 00 00 00 00 02 50 38
			23 01 00 00 00 00 02 51 38
			23 01 00 00 00 00 02 52 38
			23 01 00 00 00 00 02 53 38
			23 01 00 00 00 00 02 5B 0A
			23 01 00 00 00 00 02 5C 0A
			23 01 00 00 00 00 02 63 0A
			23 01 00 00 00 00 02 64 15
			23 01 00 00 00 00 02 68 24
			23 01 00 00 00 00 02 69 24
			23 01 00 00 00 00 02 90 7B
			23 01 00 00 00 00 02 91 11
			23 01 00 00 00 00 02 92 14
			23 01 00 00 00 00 02 7E 10
			23 01 00 00 00 00 02 7F 10
			23 01 00 00 00 00 02 80 00
			23 01 00 00 00 00 02 98 00
			23 01 00 00 00 00 02 99 00
			23 01 00 00 00 00 02 54 2E
			23 01 00 00 00 00 02 59 38
			23 01 00 00 00 00 02 5D 01
			23 01 00 00 00 00 02 5E 27
			23 01 00 00 00 00 02 62 39
			23 01 00 00 00 00 02 66 88
			23 01 00 00 00 00 02 67 11
			23 01 00 00 00 00 02 6A 0E
			23 01 00 00 00 00 02 6B 20
			23 01 00 00 00 00 02 6C 08
			23 01 00 00 00 00 02 6D 00
			23 01 00 00 00 00 02 7D 01
			23 01 00 00 00 00 02 B7 01
			23 01 00 00 00 00 02 B8 0A
			23 01 00 00 00 00 02 BA 13
			23 01 00 00 00 00 02 BC 01
			23 01 00 00 00 00 02 BD 55
			23 01 00 00 00 00 02 BE 38
			23 01 00 00 00 00 02 BF 44
			23 01 00 00 00 00 02 CF 88
			23 01 00 00 00 00 02 C8 00
			23 01 00 00 00 00 02 C9 55
			23 01 00 00 00 00 02 CA 00
			23 01 00 00 00 00 02 CB 55
			23 01 00 00 00 00 02 CC A2
			23 01 00 00 00 00 02 CE 88
			23 01 00 00 00 00 02 CF 88
			23 01 00 00 00 00 02 D0 00
			23 01 00 00 00 00 02 D1 00
			23 01 00 00 00 00 02 D3 00
			23 01 00 00 00 00 02 D5 00
			23 01 00 00 00 00 02 D6 22
			23 01 00 00 00 00 02 D7 31
			23 01 00 00 00 00 02 D8 7E
			23 01 00 00 00 00 02 FF 01
			23 01 00 00 00 00 02 FB 01
			23 01 00 00 00 00 02 6E 80
			23 01 00 00 00 00 02 FF 00
			23 01 00 00 00 00 02 FB 01
			23 01 00 00 00 00 02 D3 15
			23 01 00 00 00 00 02 D4 10
			23 01 00 00 00 00 02 D5 18
			23 01 00 00 00 00 02 D6 B8
			23 01 00 00 00 00 02 D7 00
			05 01 00 00 78 00 02 11 00
			05 01 00 00 0A 00 02 29 00
			];
		qcom,mdss-dsi-off-command = [05 01 00 00 14 00 02 28 00
				 05 01 00 00 78 00 02 10 00];
		qcom,mdss-dsi-on-command-state = "dsi_lp_mode";
		qcom,mdss-dsi-off-command-state = "dsi_hs_mode";
		/**********esd**********/
		qcom,esd-check-enabled;
		qcom,mdss-dsi-panel-status-value = <0x9C 0x00 0x00 0x02 0x40 0x80 0x00 0x00>;
		qcom,mdss-dsi-panel-status-command = [06 01 00 01 05 00 02 0A 08];
		qcom,mdss-dsi-panel-status-read-length = <8>;
		qcom,mdss-dsi-panel-max-error-count = <2>;
		qcom,mdss-dsi-panel-status-command-state = "dsi_lp_mode";
		qcom,mdss-dsi-panel-status-check-mode = "reg_read_nt35596";
		/**************esd**********/
		qcom,mdss-dsi-h-sync-pulse = <1>;
		qcom,mdss-dsi-traffic-mode = "burst_mode";
		qcom,mdss-dsi-bllp-eof-power-mode;
		qcom,mdss-dsi-bllp-power-mode;
		qcom,mdss-dsi-lane-0-state;
		qcom,mdss-dsi-lane-1-state;
		qcom,mdss-dsi-lane-2-state;
		qcom,mdss-dsi-lane-3-state;
		qcom,mdss-dsi-panel-timings = [E6 38 26 00 68 6E 2A 3C 2C 03 04 00];
		qcom,mdss-dsi-t-clk-post = <0x02>;
		qcom,mdss-dsi-t-clk-pre = <0x2B>;
		qcom,mdss-dsi-bl-min-level = <1>;
		qcom,mdss-dsi-bl-max-level = <4095>;
		qcom,mdss-dsi-dma-trigger = "trigger_sw";
		qcom,mdss-dsi-mdp-trigger = "none";
		qcom,mdss-dsi-bl-pmic-control-type = "bl_ctrl_wled";
		qcom,mdss-dsi-reset-sequence = <1 20>, <0 10>, <1 20>;
		qcom,mdss-pan-physical-width-dimension = <68>;
		qcom,mdss-pan-physical-height-dimension = <121>;
		qcom,mdss-dsi-lp11-init;
		qcom,mdss-dsi-init-delay-us = <5>;
		qcom,mdss-dsi-post-init-delay = <5>;
		qcom,mdss-dsi-avdd-avee-enabled;
		qcom,mdss-dsi-avdd-init-lcd-voltage = <5500000>;
		qcom,mdss-dsi-avee-init-lcd-voltage = <5500000>;
	};
};
